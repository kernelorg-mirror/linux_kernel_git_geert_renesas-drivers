// SPDX-License-Identifier: GPL-2.0
//
// Device Tree Overlay for SCIF1 on Salvator-X(S) Debug Serial 1 (CN26),
// using GPIO-based RTS/CTS hardware flow control
//
// Copyright (C) 2016 Glider bvba
//
// Notes:
//   - As these pins are shared with HSCIF1, the latter is disabled first.
//
// EXIO Pinout:
//   - TXD = EXIO B pin 55
//   - RXD = EXIO B pin 53 [*]
//   - RTS = EXIO B pin 49
//   - CTS = EXIO B pin 47 [*]
//   - SCK = EXIO B pin 57
//   - 3V3 = EXIO B pin 41
//   - GND = EXIO B pin 63
//
// [*] As these pins are driven by buffers connected to the CP2102, they can
//     be used for monitoring only, and not serve as inputs!

/dts-v1/;
/plugin/;

#include <dt-bindings/gpio/gpio.h>

&pfc {
	scif1_pins: scif1 {
		groups = "scif1_data_a", "scif1_clk_a";
		function = "scif1";
	};
};

&hscif1 {
	status = "disabled";
};

&scif1 {
	pinctrl-0 = <&scif1_pins>;
	pinctrl-names = "default";

	rts-gpios = <&gpio5 8 GPIO_ACTIVE_LOW>;
	cts-gpios = <&gpio5 7 GPIO_ACTIVE_LOW>;
	status = "okay";
};
