/*
 * Device Tree Source for the M3ULCB (R-Car Starter Kit Pro) board
 *
 * Copyright (C) 2016 Renesas Electronics Corp.
 * Copyright (C) 2016 Cogent Embedded, Inc.
 *
 * This file is licensed under the terms of the GNU General Public License
 * version 2.  This program is licensed "as is" without any warranty of any
 * kind, whether express or implied.
 */

#define CPG_AUDIO_CLK_I	R8A7796_CLK_S0D4

/dts-v1/;
#include "r8j7796-2x1g.dtsi"
#include "ulcb.dtsi"

/ {
	model = "Renesas M3ULCB board based on r8j7796";
	compatible = "renesas,m3ulcb", "renesas,r8j7796", "renesas,r8a7796";
};
