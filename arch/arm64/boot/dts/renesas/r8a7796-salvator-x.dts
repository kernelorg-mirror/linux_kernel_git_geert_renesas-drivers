/*
 * Device Tree Source for the Salvator-X board
 *
 * Copyright (C) 2016 Renesas Electronics Corp.
 *
 * This file is licensed under the terms of the GNU General Public License
 * version 2.  This program is licensed "as is" without any warranty of any
 * kind, whether express or implied.
 */

#define CPG_AUDIO_CLK_I		R8A7796_CLK_S0D4

/dts-v1/;
#include "r8j7796-2x2g.dtsi"
#include "salvator-x.dtsi"

/ {
	model = "Renesas Salvator-X board based on r8j7796";
	compatible = "renesas,salvator-x", "renesas,r8j7796", "renesas,r8a7796";
};
