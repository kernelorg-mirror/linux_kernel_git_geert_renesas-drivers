/*
 * Device Tree Source for the H3ULCB (R-Car Starter Kit Premier) board
 *
 * Copyright (C) 2016 Renesas Electronics Corp.
 * Copyright (C) 2016 Cogent Embedded, Inc.
 *
 * This file is licensed under the terms of the GNU General Public License
 * version 2.  This program is licensed "as is" without any warranty of any
 * kind, whether express or implied.
 */

#define CPG_AUDIO_CLK_I	R8A7795_CLK_S0D4

/dts-v1/;
#include "r8j7795-4x1g.dtsi"
#include "ulcb.dtsi"

/ {
	model = "Renesas H3ULCB board based on r8j7795";
	compatible = "renesas,h3ulcb", "renesas,r8j7795", "renesas,r8a7795";
};
