// SPDX-License-Identifier: (GPL-2.0-only OR BSD-2-Clause)
//
// Device Tree Overlay for SCIF3 on White Hawk MSIOF1 Pin Header CN5
//
// Copyright (C) 2022 Glider bv
//
// Pinout:
//   - TXD  = CN5 pin 1
//   - RXD  = CN5 pin 2
//   - SCK  = CN5 pin 6
//   - RTS# = CN5 pin 4 (SW10 must be switched to the "3" side!)
//   - CTS# = CN5 pin 3
//
//   - GND  = CN4 pin 3/4/7/11

/dts-v1/;
/plugin/;

&pfc {
	scif3_pins: scif3 {
		groups = "scif3_data", "scif3_clk", "scif3_ctrl";
		function = "scif3";
	};
};

&scif3 {
	pinctrl-0 = <&scif3_pins>;
	pinctrl-names = "default";

	uart-has-rts-cts;
	status = "okay";
};
