/*
 * Device Tree Overlay for HSCIF3 on Salvator-X(S) EXIO Connector D
 *
 * Copyright (C) 2016 Glider bvba
 *
 * This file is licensed under the terms of the GNU General Public License
 * version 2.  This program is licensed "as is" without any warranty of any
 * kind, whether express or implied.
 *
 * EXIO Pinout:
 *   - HSCIF3 TXD = EXIO D pin 30
 *   - HSCIF3 RXD = EXIO D pin 28
 */

/dts-v1/;
/plugin/;

#include <dt-bindings/clock/r8a7795-cpg-mssr.h>

/ {
	fragment-aliases {
		target-path = "/aliases";

		__overlay__ {
			/* serial3 = &hscif3; */
			serial3 = "/soc/serial@e66a0000";
		};
	};

	fragment-pfc {
		target = <&pfc>;

		__overlay__ {
			hscif3_pins: hscif3 {
				groups = "hscif3_data_d";
				function = "hscif3";
			};
		};
	};

	fragment-hscif3 {
		target = <&hscif3>;

		__overlay__ {
			pinctrl-0 = <&hscif3_pins>;
			pinctrl-names = "default";

			status = "okay";
		};
	};
};
