/*
 * Device Tree Overlay for SCIFB on r8a7740/Armadillo-800 EVA Expansion
 * Interface Connector, using GPIO-based RTS/CTS hardware flow control
 *
 * Copyright (C) 2016 Glider bvba
 *
 * This file is licensed under the terms of the GNU General Public License
 * version 2.  This program is licensed "as is" without any warranty of any
 * kind, whether express or implied.
 *
 * Pinout:
 *   - TXD = CON15 pin 40
 *   - RXD = CON15 pin 41
 *   - RTS = CON15 pin 44
 *   - CTS = CON15 pin 47
 *   - SCK = CON15 pin 42
 */

/dts-v1/;
/plugin/;

#include <dt-bindings/gpio/gpio.h>

/ {
	fragment-aliases {
		target-path = "/aliases";

		__overlay__ {
			/* serial8 = &scifb; */
			serial8 = "/serial@e6c30000";
		};
	};

	fragment-pfc {
		target = <&pfc>;

		__overlay__ {
			scifb_pins: scifb {
				groups = "scifb_data_0", "scifb_clk_0";
				function = "scifb";
			};
		};
	};

	fragment-scifb {
		target = <&scifb>;

		__overlay__ {
			pinctrl-0 = <&scifb_pins>;
			pinctrl-names = "default";

			rts-gpios = <&pfc 23 GPIO_ACTIVE_LOW>;
			cts-gpios = <&pfc 21 GPIO_ACTIVE_LOW>;
			status = "okay";
		};
	};
};
