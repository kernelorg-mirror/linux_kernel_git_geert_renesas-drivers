/*
 * Device Tree Overlay for SCIFB0 on r8a7791/Koelsch EXIO Connector A
 *
 * Copyright (C) 2015 Glider bvba
 *
 * This file is licensed under the terms of the GNU General Public License
 * version 2.  This program is licensed "as is" without any warranty of any
 * kind, whether express or implied.
 *
 * Pinout:
 *   - TXD = EXIO Connector A pin 60
 *   - RXD = EXIO Connector A pin 66
 *   - RTS = EXIO Connector A pin 62
 *   - CTS = EXIO Connector A pin 65
 */

/dts-v1/;
/plugin/;

/ {
	fragment-aliases {
		target-path = "/aliases";

		__overlay__ {
			/* serial12 = &scifb0; */
			serial12 = "/serial@e6c20000";
		};
	};

	fragment-pfc {
		target = <&pfc>;

		__overlay__ {
			scifb0_pins: scifb0 {
				groups = "scifb0_data_b", "scifb0_ctrl_b";
				function = "scifb0";
			};
		};
	};

	fragment-scifb0 {
		target = <&scifb0>;

		__overlay__ {
			pinctrl-0 = <&scifb0_pins>;
			pinctrl-names = "default";

			uart-has-rtscts;
			status = "okay";
		};
	};
};
