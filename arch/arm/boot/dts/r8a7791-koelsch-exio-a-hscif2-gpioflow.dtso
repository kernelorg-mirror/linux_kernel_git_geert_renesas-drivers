/*
 * Device Tree Overlay for HSCIF2 on r8a7791/Koelsch EXIO Connector A, using
 * GPIO-based RTS/CTS hardware flow control
 *
 * Copyright (C) 2016 Glider bvba
 *
 * This file is licensed under the terms of the GNU General Public License
 * version 2.  This program is licensed "as is" without any warranty of any
 * kind, whether express or implied.
 *
 * Pinout:
 *   - TXD = EXIO Connector A pin 62
 *   - RXD = EXIO Connector A pin 66
 *   - RTS = EXIO Connector A pin 65
 *   - CTS = EXIO Connector A pin 60
 */

/dts-v1/ /plugin/;

#include <dt-bindings/gpio/gpio.h>

/ {
	fragment-aliases {
		target-path = "/aliases";

		__overlay__ {
			/* serial17 = &hscif2; */
			serial17 = "/serial@e62d0000";
		};
	};

	fragment-pfc {
		target = <&pfc>;

		__overlay__ {
			hscif2_pins: hscif2 {
				groups = "hscif2_data_b";
				function = "hscif2";
			};
		};
	};

	fragment-hscif2 {
		target = <&hscif2>;

		__overlay__ {
			pinctrl-0 = <&hscif2_pins>;
			pinctrl-names = "default";

			rts-gpios = <&gpio1 23 GPIO_ACTIVE_LOW>;
			cts-gpios = <&gpio1 21 GPIO_ACTIVE_LOW>;
			status = "okay";
		};
	};
};
