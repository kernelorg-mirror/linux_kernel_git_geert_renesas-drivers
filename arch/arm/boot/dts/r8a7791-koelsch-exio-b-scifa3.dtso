/*
 * Device Tree Overlay for SCIFA3(b) on r8a7791/Koelsch EXIO Connector B
 *
 * Copyright (C) 2015 Glider bvba
 *
 * This file is licensed under the terms of the GNU General Public License
 * version 2.  This program is licensed "as is" without any warranty of any
 * kind, whether express or implied.
 *
 * Pinout:
 *   - TXD = EXIO Connector B pin 8
 *   - RXD = EXIO Connector B pin 10
 *   - SCK = EXIO Connector B pin 12
 */

/dts-v1/ /plugin/;

/ {
	fragment-aliases {
		target-path = "/aliases";

		__overlay__ {
			/* serial9 = &scifa3; */
			serial9 = "/serial@e6c70000";
		};
	};

	fragment-pfc {
		target = <&pfc>;

		__overlay__ {
			scifa3_pins: scifa3 {
				groups = "scifa3_data_c", "scifa3_clk_c";
				function = "scifa3";
			};
		};
	};

	fragment-scifa3 {
		target = <&scifa3>;

		__overlay__ {
			pinctrl-0 = <&scifa3_pins>;
			pinctrl-names = "default";

			status = "okay";
		};
	};
};
