/*
 * Device Tree Overlay for SCIFB0 on r8a7791/Koelsch EXIO Connector A, using
 * GPIO-based RTS/CTS hardware flow control
 *
 * Copyright (C) 2016 Glider bvba
 *
 * This file is licensed under the terms of the GNU General Public License
 * version 2.  This program is licensed "as is" without any warranty of any
 * kind, whether express or implied.
 *
 * Pinout:
 *   - TXD = EXIO Connector A pin 60
 *   - RXD = EXIO Connector A pin 66
 *   - RTS = EXIO Connector A pin 62
 *   - CTS = EXIO Connector A pin 65
 */

/dts-v1/;
/plugin/;

#include <dt-bindings/gpio/gpio.h>

/ {
	fragment-aliases {
		target-path = "/aliases";

		__overlay__ {
			/* serial12 = &scifb0; */
			serial12 = "/serial@e6c20000";
		};
	};

	fragment-pfc {
		target = <&pfc>;

		__overlay__ {
			scifb0_pins: scifb0 {
				groups = "scifb0_data_b";
				function = "scifb0";
			};
		};
	};

	fragment-scifb0 {
		target = <&scifb0>;

		__overlay__ {
			pinctrl-0 = <&scifb0_pins>;
			pinctrl-names = "default";

			rts-gpios = <&gpio1 22 GPIO_ACTIVE_LOW>;
			cts-gpios = <&gpio1 23 GPIO_ACTIVE_LOW>;
			status = "okay";
		};
	};
};
