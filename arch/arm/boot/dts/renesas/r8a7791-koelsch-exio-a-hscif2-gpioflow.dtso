// SPDX-License-Identifier: GPL-2.0
//
// Device Tree Overlay for HSCIF2 on r8a7791/Koelsch EXIO Connector A, using
// GPIO-based RTS/CTS hardware flow control
//
// Copyright (C) 2016 Glider bvba
//
// Pinout:
//   - TXD = EXIO A pin 62
//   - RXD = EXIO A pin 66
//   - RTS = EXIO A pin 65
//   - CTS = EXIO A pin 60
//   - GND = EXIO A pin 73/77/78

/dts-v1/;
/plugin/;

#include <dt-bindings/gpio/gpio.h>

&pfc {
	hscif2_pins: hscif2 {
		groups = "hscif2_data_b";
		function = "hscif2";
	};
};

&hscif2 {
	pinctrl-0 = <&hscif2_pins>;
	pinctrl-names = "default";

	rts-gpios = <&gpio1 23 GPIO_ACTIVE_LOW>;
	cts-gpios = <&gpio1 21 GPIO_ACTIVE_LOW>;
	status = "okay";
};
