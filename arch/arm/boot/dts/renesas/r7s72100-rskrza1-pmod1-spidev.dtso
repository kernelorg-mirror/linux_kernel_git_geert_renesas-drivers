// SPDX-License-Identifier: GPL-2.0-only
//
// Device Tree Overlay for spidev on RSK+RZA1 PMOD Connector 1 (CN25)
//
// Copyright (C) 2019 Glider bvba
//
// Pinout:
//   - CS#  = pin 1
//   - MOSI = pin 2
//   - MISO = pin 3
//   - SCK  = pin 4
//   - GND  = pin 5/11
//   - +3V3 = pin 6/12

/dts-v1/;
/plugin/;

&spi1 {
	#address-cells = <1>;
	#size-cells = <0>;

	cn25@0 {
		compatible = "renesas,rskrza1-pmod1-spi";
		reg = <0>;

		spi-max-frequency = <33333333>;
	};
};
