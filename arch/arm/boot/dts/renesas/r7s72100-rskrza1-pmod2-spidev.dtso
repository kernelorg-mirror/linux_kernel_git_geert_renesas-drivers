// SPDX-License-Identifier: GPL-2.0-only
//
// Device Tree Overlay for spidev on RSK+RZA1 PMOD Connector 2 (CN26)
//
// Copyright (C) 2019 Glider bvba
//
// Pinout:
//   - CS#  = pin 1
//   - MOSI = pin 2
//   - MISO = pin 3
//   - SCK  = pin 4
//   - GND  = pin 5/11
//   - +3V3 = pin 6/12

/dts-v1/;
/plugin/;

&spi1 {
	#address-cells = <1>;
	#size-cells = <0>;

	cn26@1 {
		compatible = "renesas,rskrza1-pmod2-spi";
		reg = <1>;

		spi-max-frequency = <33333333>;
	};
};
