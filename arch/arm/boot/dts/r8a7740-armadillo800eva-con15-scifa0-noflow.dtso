/*
 * Device Tree Overlay for SCIFA0 on r8a7740/Armadillo-800 EVA Expansion
 * Interface Connector, with RTS/CTS hardware flow control disabled
 *
 * Copyright (C) 2016 Glider bvba
 *
 * This file is licensed under the terms of the GNU General Public License
 * version 2.  This program is licensed "as is" without any warranty of any
 * kind, whether express or implied.
 *
 * Pinout:
 *   - TXD = CON15 pin 25
 *   - RXD = CON15 pin 23
 */

/dts-v1/;
/plugin/;

/ {
	fragment-aliases {
		target-path = "/aliases";

		__overlay__ {
			/* serial1 = &scifa0; */
			serial1 = "/serial@e6c40000";
		};
	};

	fragment-pfc {
		target = <&pfc>;

		__overlay__ {
			scifa0_pins: scifa0 {
				groups = "scifa0_data";
				function = "scifa0";
			};
		};
	};

	fragment-scifa0 {
		target = <&scifa0>;

		__overlay__ {
			pinctrl-0 = <&scifa0_pins>;
			pinctrl-names = "default";

			status = "okay";
		};
	};
};
