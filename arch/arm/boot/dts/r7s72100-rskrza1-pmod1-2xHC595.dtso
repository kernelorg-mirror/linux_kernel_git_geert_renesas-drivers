// SPDX-License-Identifier: GPL-2.0-only
//
// Device Tree Overlay for 2xHC595 on RSK+RZA1 PMOD Connector 1 (CN25)
//
// Copyright (C) 2019 Glider bvba
//
// Pinout:
//   - CS#  = pin 1
//   - MOSI = pin 2
//   - MISO = pin 3
//   - SCK  = pin 4
//   - GND  = pin 5/11
//   - +3V3 = pin 6/12

/dts-v1/;
/plugin/;

&spi1 {
	#address-cells = <1>;
	#size-cells = <0>;

	hc595s: gpio@0 {
		compatible = "fairchild,74hc595";
		reg = <0>;

		gpio-controller;
		#gpio-cells = <2>;
		registers-number = <2>;
		spi-max-frequency = <100000>;
	};
};
