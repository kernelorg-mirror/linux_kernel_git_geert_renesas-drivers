// SPDX-License-Identifier: GPL-2.0-only
//
// Device Tree Overlay for spidev on RSK+RZA1 PMOD Connector 2 (CN26)
//
// Copyright (C) 2019 Glider bvba
//
// Pinout:
//   - CS#  = pin 1
//   - MOSI = pin 2
//   - MISO = pin 3
//   - SCK  = pin 4

/dts-v1/;
/plugin/;

&spi1 {
	#address-cells = <1>;
	#size-cells = <0>;

	spidev@1 {
		compatible = "spidev";
		reg = <1>;

		spi-max-frequency = <100000>;
	};
};
