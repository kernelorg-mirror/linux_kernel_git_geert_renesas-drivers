## Documentation/devicetree/bindings/reset/renesas,rst.txt
```
DT bindings for the Renesas R-Car Reset Controller

The R-Car Reset Controller provides reset control, and implements the following
functions:
  - Register-based reset control for the various CPU cores,
  - Latching of the levels on mode pins when PRESET# is negated,
  - Mode monitoring register,
  - Boot address registers for the various CPU cores.


Required properties:
  - compatible: Should be "renesas,rst-<soctype>", and "syscon".
		Examples with soctypes are:
		  - "renesas,rst-r8a7790" (R-Car H2)
		  - "renesas,rst-r8a7791" (R-Car M2-W)
		  - "renesas,rst-r8a7792" (R-Car V2H
		  - "renesas,rst-r8a7793" (R-Car M2-N)
		  - "renesas,rst-r8a7794" (R-Car E2)
		  - "renesas,rst-r8a7795" (R-Car H3)
  - reg: Address start and address range for the device.


Example:

	rst: reset-controller@e6160000 {
		compatible = "renesas,rst-r8a7795", "syscon";
		reg = <0 0xe6160000 0 0x0200>;
	};
```
